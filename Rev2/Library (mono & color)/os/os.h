// ************************************************************************
// ***** Header library of the Arduino 'Nano Home Computer'           *****
// ***** written by Carsten Herting (slu4), last update: 17.07.2023   *****
// ***** copy 'os.h' and 'os.S' into a folder '/Arduino/libraries/os' *****
// ************************************************************************

namespace os
{  
  #define ROWS				25					// number of rows of VGA text output
	#define COLS				40					// number of columns of VGA text output
	#define KEYBUFSIZE  8						// keyboard input ring buffer size

	#define BLACK				0b0000			// color codes
	#define DKGRAY			0b0001
	#define DKRED				0b0010
	#define DKGREEN			0b0100
	#define DKYELLOW		0b0110
	#define DKBLUE			0b1000
	#define DKMAGENTA		0b1010
	#define DKCYAN			0b1100
	#define RED					0b0011
	#define GREEN				0b0101
	#define YELLOW			0b0111
	#define BLUE				0b1001
	#define MAGENTA			0b1011
	#define CYAN				0b1101
	#define GRAY				0b1110
	#define WHITE				0b1111

  const volatile byte __attribute__ ((aligned (256))) charset[8][256] asm("charset") PROGMEM =
  {
    0x00,0x00,0x00,0x00,0x00,0x00,0x00,0x00,0x00,0x00,0x00,0x00,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0xFF,
    0x00,0x00,0x00,0x00,0x00,0x00,0x00,0x00,0x00,0x00,0x00,0x00,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0xEF,
    0x00,0x00,0x00,0x00,0x00,0x00,0x00,0x00,0x00,0x00,0x00,0x00,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0xCF,
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    0x00,0x00,0x00,0x00,0x00,0x00,0x00,0x00,0x00,0x00,0x00,0x00,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0xFF,
  };

  volatile byte vram[ROWS][COLS] asm("vram"); 		// array of character video RAM data
  volatile byte cram[ROWS] asm("cram"); 					// array of color video RAM data
  volatile byte reg[KEYBUFSIZE] asm("reg");  			// ring buffer data of keyboard input register
  volatile byte regout asm("regout") = 0;       	// index of current output position in queue
  volatile byte regin asm("regin") = 0;        		// index of current input position in queue
	volatile byte prev asm("prev") = 1;				      // PS/2 previous sample of CLK, used for edge detection
  volatile byte cnts asm("cnts") = 0;             // PS/2 received bits counter
  volatile int data asm("data") = 0;              // PS/2 datagram as it is received bit by bit
  volatile int frames = 0;												// counting the displayed frames (60Hz)
  volatile int vline asm("vline") = 0;         		// current vertical position of pixel video output

  const byte ScanToASCII[3][128] PROGMEM =  			// [x][..]: SHIFT/ALTGR keystate and PS/2 scancode, [..][y]: ASCII code)
  { 
    { 0,0,0,0,0,0,0,0,         0,0,0,0,0,9,94,0,         0,0,0,0,0,113,49,0,       0,0,121,115,97,119,50,0,     // plain keys
      0,99,120,100,101,52,51,0,0,32,118,102,116,114,53,0,0,110,98,104,103,122,54,0,0,0,109,106,117,55,56,0,
      0,44,107,105,111,48,57,0,0,46,45,108,0,112,0,0,    0,0,0,0,0,96,0,0,         0,0,10,43,0,35,0,0,
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      0,124,0,0,0,0,0,0,       0,0,0,0,0,0,0,0,          0,0,0,0,0,0,0,0,          0,0,0,0,0,0,0,0          }
  };
    
  char getkey()
  {
    static bool altgr = false;    // state of some important keys of the PS2 keyboard
    static bool shift = false;
    static bool relea = false;    // indicating that the next key was released
    while(regout != regin)        // are any unread input in the ring buffer?
    {
      byte scan = reg[regout++];  // take a character from output position
      regout &= (KEYBUFSIZE-1);   // make index wrap around      
      switch (scan)
      {
        case 0xf0: relea = true; break;                          // key release indicator      
        case 0xe0: break;                                        // ignore prefix of special keys
        case 17: altgr = !relea; relea = false; break;           // ALT, ALTGR
        case 18: case 89: shift = !relea; relea = false; break;  // treat LSHIFT and RSHIFT the same
        default:                                                 // any other key
          if (relea == true) relea = false;                      // key released => don't emit anything
          else  									                               // key pressed => emit ASCII code according to lookup table
          {
            byte s=0; if (shift) s = 1; else if (altgr) s = 2;   // select bank of lookup according to states of special keys
            return pgm_read_byte_near(&ScanToASCII[s][scan & 127]);
          }
          break;
      }
    }
    return 0;
  }  

  void fill(char c = 32) { memset((void*)vram, c, ROWS*COLS); }

  void text(const String s, byte x, byte y, byte col=0)
	{
		memcpy((void*)&vram[y][x], (void*)s.c_str(), s.length());
		if (col != 0) cram[y] = col;
	}

	void wait(unsigned int dt) { unsigned int t = os::frames; while(os::frames < t + dt); }

  void scroll()
	{
		memcpy((void*)&vram[0][0], (void*)&vram[1][0], (ROWS-1)*COLS);	// scroll video RAM
		memset((void*)&vram[24][0], 32, COLS);

		memcpy((void*)&cram[0], (void*)&cram[1], ROWS-1);								// scroll color RAM
		cram[24] = WHITE;
	}
  
  void init()
  {
    noInterrupts();                   // disable interrupts before messing around with timer registers

    DDRC  = 0b00111100;               // PORTC is always input
    PORTC = 0b00111111;               // enable 20k pull-up resistors for CLK and DAT of PS/2
    DDRD  = 0b11111111;               // PORTD is always output
    PORTD = 0b00000000;
    DDRB  = 0b00111100;               // B0: CLKO, B2: /VSYNC (timer1), B3: /PE by hand, B4: /HSYNC by hand in ISR
    PORTB = 0b00011100;               // B0: CLKO, B2: /VSYNC=1, B3: /PE=1, B4: /HSYNC=1
               
    GTCCR = 0b10000011;               // set TSM, PSRSYNC und PSRASY to correlate all 3 timers
  
    // *****************************
    // ***** Timer0: VGA HSYNC *****
    // *****************************
    TCNT0  = 4;                       // aligns VSYNC and HSYNC pulses
    TCCR0A = (1 << WGM01) | (0 << WGM00);   // mode 2: Clear Timer on Compare Match (CTC)
    TCCR0B = (0 << WGM02) | (0 << CS02) | (1 << CS01) | (0 << CS00); // x8 prescaler -> 0.5µs
    OCR0A  = 63;                      // 60cols (24MHz): 95, 40cols (16MHz): 63, compare match register A (TOP) -> 32µs
    TIMSK0 = (1 << OCIE0A);           // Output Compare Match A Interrupt Enable (not working: TOIE1 with ISR TIMER0_TOIE1_vect because it is already defined by timing functions)
  
    // *****************************
    // ***** Timer1: VGA VSYNC *****
    // *****************************
    TCNT1  = 0;
    TCCR1A = (1 << COM1B1) | (1 << COM1B0) | (1 << WGM11) | (1 << WGM10); // mode 15 (Fast PWM), set OC1B on Compare Match, clear OC1B at BOTTOM, controlling OC1B pin 10
    TCCR1B = (1 << WGM13) | (1 << WGM12) | (1 << CS12) | (0 << CS11) | (1 << CS10); // x1024 prescaler -> 64µs
    OCR1A  = 259;                     // 60cols (24MHz): 389, 40cols (16MHz): 259, compare match register A (TOP) -> 16.64ms
    OCR1B  = 0;                       // compare match register B -> 64µs
    TIMSK1 = (1 << TOIE1);            // enable timer overflow interrupt setting vlines = 0
  
    // ************************************************
    // ***** Timer2: only used for jitter control *****
    // ************************************************
    TCNT2  = 0;
    TCCR2A = (0<<COM2A1) | (0<<COM2A0) | (1<<WGM21) | (1<<WGM20); // mode 7: Fast PWM, COM2A0=0: normal port HIGH, COM2A0=1: Toggle OC2A pin 11 on Compare Match
    TCCR2B = (1<<WGM22) | (0<<CS22) | (0<<CS21) | (1<<CS20) ;     // set x0 prescaler -> 62.5ns;
    OCR2A  = 7;                   		// compare match register A (TOP) -> 250ns
    TIMSK2 = 0;                   		// no interrupts here
  
    GTCCR = 0;                        // clear TSM => all timers start synchronously
		UCSR0B = 0;                       // brute-force the USART off just in case...

    interrupts();
  }

	ISR(TIMER1_OVF_vect) { vline = 0; frames++; }  // timer1 overflow interrupt resets vline counter at HSYNC
}

int main()                        		// enforce main() loop w/o serial handler
{
	memset((void*)os::vram, 32, ROWS*COLS);	// clear the video RAM
	memset((void*)os::cram, 15, ROWS);			// set color RAM to white
	os::text(F("***** Nano Home Computer 2.0 *****"), 3, 0, YELLOW);
	os::text(F("26KB of FLASH and 1KB of SRAM free"), 3, 2, CYAN);
  setup();
  os::init();													// initialize Nano OS
  while(true) loop();
}

/*
-----------
MIT License
-----------
Copyright (c) 2023 Carsten Herting
Permission is hereby granted, free of charge, to any person obtaining a copy of
this software and associated documentation files (the "Software"), to deal in
the Software without restriction, including without limitation the rights to
use, copy, modify, merge, publish, distribute, sublicense, and/or sell copies
of the Software, and to permit persons to whom the Software is furnished to do
so, subject to the following conditions:
The above copyright notice and this permission notice shall be included in all
copies or substantial portions of the Software.
THE SOFTWARE IS PROVIDED "AS IS", WITHOUT WARRANTY OF ANY KIND, EXPRESS OR
IMPLIED, INCLUDING BUT NOT LIMITED TO THE WARRANTIES OF MERCHANTABILITY,
FITNESS FOR A PARTICULAR PURPOSE AND NONINFRINGEMENT. IN NO EVENT SHALL THE
AUTHORS OR COPYRIGHT HOLDERS BE LIABLE FOR ANY CLAIM, DAMAGES OR OTHER
LIABILITY, WHETHER IN AN ACTION OF CONTRACT, TORT OR OTHERWISE, ARISING FROM,
OUT OF OR IN CONNECTION WITH THE SOFTWARE OR THE USE OR OTHER DEALINGS IN THE
SOFTWARE.
*/
